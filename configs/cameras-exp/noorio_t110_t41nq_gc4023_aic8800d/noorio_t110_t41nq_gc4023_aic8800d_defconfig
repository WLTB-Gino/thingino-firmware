## configs/cameras/jooan_c9ts_t23n_sc2336p_swt6621s/jooan_c9ts_t23n_sc2336p_swt6621s_defconfig
```kconfig
# NAME: Jooan C9TS-U (T23N, SC2336P, SWT6621S) - HW revision with Seekwave WiFi
# FRAG: soc-xburst1 core
BR2_INGENIC_SOC_MODEL="t23n"
BR2_ISP_CLK_300MHZ=y
BR2_PACKAGE_PRUDYNT_T_NO_HW_IVS=y
BR2_PACKAGE_THINGINO_KOPT_MMC0=y
BR2_PACKAGE_THINGINO_KOPT_MMC0_PB_4BIT=y
BR2_PACKAGE_THINGINO_STREAMER_PRUDYNT=y
BR2_PACKAGE_WIFI=y
BR2_PACKAGE_WIFI_SWT6621S=y
BR2_SENSOR_1_IQ_FILE="configs/cameras/jooan_c9ts_t23n_sc2336p_swt6621s/cv2005-t23.bin"
BR2_SENSOR_1_NAME="cv2005"
BR2_THINGINO_AUDIO=y
BR2_THINGINO_BUTTON=y
BR2_THINGINO_MOTORS=y
BR2_THINGINO_SDCARD=y
FLASH_SIZE_MB=8
```
